## sdkconfig.defaults
```kconfig
#
# Chip target
#
CONFIG_IDF_TARGET="esp32h2"
# end of Chip target

#
# Partition Table
#
CONFIG_PARTITION_TABLE_CUSTOM=y
CONFIG_PARTITION_TABLE_CUSTOM_FILENAME="partitions.csv"
CONFIG_PARTITION_TABLE_FILENAME="partitions.csv"
CONFIG_PARTITION_TABLE_OFFSET=0x8000
CONFIG_PARTITION_TABLE_MD5=y
# end of Partition Table

#
# mbedTLS
#
CONFIG_MBEDTLS_HARDWARE_AES=n
CONFIG_MBEDTLS_HARDWARE_MPI=n
CONFIG_MBEDTLS_HARDWARE_SHA=n
CONFIG_MBEDTLS_CMAC_C=y
CONFIG_MBEDTLS_SSL_PROTO_DTLS=y
CONFIG_MBEDTLS_KEY_EXCHANGE_ECJPAKE=y
# end of TLS Key Exchange Methods

CONFIG_MBEDTLS_ECJPAKE_C=y
# end of mbedTLS

#
# Zboss
#
CONFIG_ZB_ENABLED=y
CONFIG_ZB_ZED=y
# end of Zboss
# end of Component config


#
# light sleep configuration
#
CONFIG_PM_ENABLE=y
CONFIG_FREERTOS_USE_TICKLESS_IDLE=y
CONFIG_PM_POWER_DOWN_PERIPHERAL_IN_LIGHT_SLEEP=y
CONFIG_IEEE802154_SLEEP_ENABLE=y
# Use 1000Hz freertos tick to lower sleep time threshold
CONFIG_FREERTOS_HZ=1000
CONFIG_ESP_SLEEP_POWER_DOWN_FLASH=y
# end of light sleep

#
# Console over native USB (USB-Serial-JTAG) for the ESP32-H2 Supermini.
# UART stays the primary console; USB is enabled as the secondary so logs
# reach the USB port. Raise the default log level to INFO (max tracks it via
# LOG_MAXIMUM_EQUALS_DEFAULT) so INFO messages are emitted at runtime.
#
CONFIG_USJ_ENABLE_USB_SERIAL_JTAG=y
CONFIG_ESP_CONSOLE_SECONDARY_USB_SERIAL_JTAG=y
CONFIG_LOG_DEFAULT_LEVEL_INFO=y
# end of console
```
